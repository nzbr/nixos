/dts-v1/;
/plugin/;

/ {
    compatible = "brcm,bcm2835";

    fragment@0 {
        target = <&i2c_arm>;
        __overlay__ {
            #address-cells = <1>;
            #size-cells = <0>;

            light-sensor@39 {
                compatible = "amstaos,tsl2561";
                reg = <0x39>;
                amstaos,cover-comp-gain = <16>;
            };
        };
    };
};
